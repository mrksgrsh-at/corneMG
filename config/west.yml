## config/west.yml
```yaml
manifest:
  remotes:
    - name: zmkfirmware
      url-base: https://github.com/zmkfirmware
    # Additional modules containing boards/shields/custom code can be listed here as well
    # See https://docs.zephyrproject.org/3.2.0/develop/west/manifest.html#projects
    - name: infely                             # nice-view-battery
      url-base: https://github.com/infely      # nice-view-battery
  projects:
    - name: zmk
      remote: zmkfirmware
      revision: main
      import: app/west.yml
    - name: nice-view-battery                  # nice-view-battery
      remote: infely                           # nice-view-battery
      revision: main                           # nice-view-battery
  self:
    path: config
```
